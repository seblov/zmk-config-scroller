#include "scroller.dtsi"

/ {
    chosen {
      zmk,kscan = &kscan; 
    };
    kscan: kscan {
        compatible = "zmk,kscan-gpio-direct";
         wakeup-source;

         input-gpios
         = <&pro_micro 10 (GPIO_ACTIVE_LOW | GPIO_PULL_UP)>
        , <&pro_micro 11 (GPIO_ACTIVE_LOW | GPIO_PULL_UP)>;
};
&rotary_encoder_0 {
    status = "okay";
};